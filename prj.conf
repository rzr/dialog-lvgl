## CMakeLists.txt
```
# SPDX-License-Identifier: Apache-2.0

cmake_minimum_required(VERSION 3.20.0)

find_package(Zephyr REQUIRED HINTS $ENV{ZEPHYR_BASE})
project(lvgl)

target_sources(app PRIVATE src/os/zephyr/main.c src/widgets/keypad.c)
```

## prj.conf
```kconfig
CONFIG_HEAP_MEM_POOL_SIZE=16384
CONFIG_MAIN_STACK_SIZE=2048

CONFIG_DISPLAY=y
CONFIG_DISPLAY_LOG_LEVEL_ERR=y

CONFIG_LOG=y

CONFIG_LVGL=y
CONFIG_LVGL_USE_LABEL=y
CONFIG_LVGL_USE_CONT=y
CONFIG_LVGL_USE_BTN=y
CONFIG_LVGL_USE_THEME_MATERIAL=y
CONFIG_LVGL_USE_BTNMATRIX=y
CONFIG_LVGL_USE_TEXTAREA=y
CONFIG_LVGL_USE_LABEL=y
CONFIG_LVGL_USE_PAGE=y
```

## src/main.c
```c
// -*- mode: C++; c-basic-offset: 4; indent-tabs-mode: nil -*-
// vim: ft=cpp:expandtab:ts=4:sw=4:softtabstop=4:
// SPDX-FileCopyrightText: Huawei Inc.
// SPDX-License-Identifier: MIT

#define _DEFAULT_SOURCE /* needed for usleep() */
#include <stdio.h>
#include <stdlib.h>
#include <unistd.h>

#include <lvgl/lvgl.h>

static void hal_init(void); /* see {sdl,...}.c */

#include "widgets/msgbox.h"
#include "widgets/yesno.h"
#include "widgets/inputbox.h"
#include "widgets/checklist.h"


char * usage(int argc, char ** argv)
{
    printf("Usage: %s, <COMMAND> [OPTIONS]\n\
\n\
Description:\n\
 Basic UI utility to be used in scripts.\n\
 Inspired by ncurses' dialog, implemented using LVGL\n\
\n\
Commands: \n\
 --msgbox \"message\" 0 0\n\
 --yesno  \"message\" 0 0\n\
 --inputbox \"message\" 0 0\n\
 --checklist  \"message\" 0 0 0 \"keyword1\" \"Description1\" \"ON\" ... \n\
\n\
", argv[0]);
}


void default_ui_init(int argc, char ** argv)
{
    usage(argc, argv);
    char * msgbox_argv[] = {
        argv[0],
        "--msgbox",
        "Basic UI utility to be used in scripts.\n\
Inspired by ncurses dialog, implemented using LVGL\n\
For help run again with '--help' command option"
    };
    msgbox_ui_init(3, msgbox_argv);
}


void ui_init(int argc, char ** argv)
{
    lv_obj_set_flex_flow(lv_scr_act(), LV_FLEX_FLOW_COLUMN);
    lv_obj_set_flex_align(lv_scr_act(),
                          LV_FLEX_ALIGN_CENTER, LV_FLEX_ALIGN_CENTER,
                          LV_FLEX_ALIGN_CENTER);
    if((argc >= 1) && (argv[1])) {
        if(strcmp(argv[1], "--msgbox") == 0) {
            msgbox_ui_init(argc, argv);
        }
        else if(strcmp(argv[1], "--yesno") == 0) {
            yesno_ui_init(argc, argv);
        }
        else if(strcmp(argv[1], "--inputbox") == 0) {
            inputbox_ui_init(argc, argv);
        }
        else if(strcmp(argv[1], "--checklist") == 0) {
            checklist_ui_init(argc, argv);
        }
        else {
            default_ui_init(argc, argv);
        }
    }
    else {
        default_ui_init(argc, argv);
    }
}



int main(int argc, char ** argv)
{
    if((argc > 1) && strcmp(argv[1], "--help") == 0) {
        usage(argc, argv);
        return 0;
    }

    lv_init();
    hal_init();
    ui_init(argc, argv);

    while(1) {
        lv_timer_handler();
        usleep(5 * 1000);
    }
    return 0;
}
```

## src/checklist.c
```c
// -*- mode: C++; c-basic-offset: 4; indent-tabs-mode: nil -*-
// vim: ft=cpp:expandtab:ts=4:sw=4:softtabstop=4:
// SPDX-FileCopyrightText: Huawei Inc.
// SPDX-License-Identifier: MIT

#include <stdio.h>
#include <stdlib.h>
#include <lvgl/lvgl.h>
#include "checklist.h"


static lv_obj_t * * checklist_model = 0;
static int checklist_model_size = 0;


static void ok_checklist_event_handler(lv_event_t * e)
{
    lv_event_code_t code = lv_event_get_code(e);
    if(code == LV_EVENT_CLICKED) {
        for(int i = 0; i < checklist_model_size; i++) {
            lv_obj_t * cb = checklist_model[i];
            if(lv_obj_get_state(cb) == LV_STATE_CHECKED) {
                fprintf(stderr, "%s\n", (char *) lv_obj_get_user_data(cb));
            }
        }
        checklist_ui_free();
        exit(0);
    }
}

static void cancel_checklist_event_handler(lv_event_t * e)
{
    lv_event_code_t code = lv_event_get_code(e);
    if(code == LV_EVENT_CLICKED) {
        exit(2);
    }
}


void checklist_ui_init(int argc, char ** argv)
{
    lv_obj_t * label1 = lv_label_create(lv_scr_act());
    char * text = (argc > 2) ? argv[2] : "";
    lv_label_set_text(label1, text);

    int i = 3 + 3; // skip w,h,d
    int index = 0;
    checklist_model_size = (argc - 2 - 4) / 3;
    checklist_model = malloc(checklist_model_size * sizeof(lv_obj_t));

    lv_obj_set_flex_flow(lv_scr_act(), LV_FLEX_FLOW_COLUMN);
    lv_obj_set_flex_align(lv_scr_act(), LV_FLEX_ALIGN_CENTER, LV_FLEX_ALIGN_START, LV_FLEX_ALIGN_CENTER);

    while(i < argc - 2) {
        char * title = argv[i++];
        char * desc = argv[i++];
        char * onoff = argv[i++];
        int len = strlen(title) + sizeof(':') + strlen(desc) + sizeof('\0');
        char * text = malloc(len);
        snprintf(text, len, "%s:%s", title, desc);
        int state = (strcmp("ON", onoff) == 0) ? LV_STATE_CHECKED : LV_STATE_DEFAULT;

        lv_obj_t * cb = lv_checkbox_create(lv_scr_act());
        checklist_model[index] = cb;
        lv_checkbox_set_text(cb, text);
        lv_obj_set_user_data(cb, title);
        lv_obj_add_state(cb, state);

        index++;
    }

    {
        lv_obj_t * btn = lv_btn_create(lv_scr_act());
        lv_obj_add_event_cb(btn, ok_checklist_event_handler, LV_EVENT_ALL, NULL);
        lv_obj_t * label = lv_label_create(btn);
        lv_label_set_text(label, "OK");
    }

    {
        lv_obj_t * btn = lv_btn_create(lv_scr_act());
        lv_obj_add_event_cb(btn, cancel_checklist_event_handler, LV_EVENT_ALL, NULL);
        lv_obj_t * label = lv_label_create(btn);
        lv_label_set_text(label, "Cancel");
    }
}


void checklist_ui_free()
{
    free(checklist_model);
}
```

## src/inputbox.c
```c
// -*- mode: C++; c-basic-offset: 4; indent-tabs-mode: nil -*-
// vim: ft=cpp:expandtab:ts=4:sw=4:softtabstop=4:
// SPDX-FileCopyrightText: Huawei Inc.
// SPDX-License-Identifier: MIT

#include <stdio.h>
#include <stdlib.h>
#include <lvgl/lvgl.h>
#include "inputbox.h"

const char * inputbox_value = "";

static void ok_inputbox_event_handler(lv_event_t * e)
{
    lv_event_code_t code = lv_event_get_code(e);
    lv_obj_t * obj = lv_event_get_target(e);
    if(code == LV_EVENT_CLICKED) {
        fprintf(stderr, "%s\n",  inputbox_value);
        exit(0);
    }
}

static void cancel_inputbox_event_handler(lv_event_t * e)
{
    lv_event_code_t code = lv_event_get_code(e);
    lv_obj_t * obj = lv_event_get_target(e);
    if(code == LV_EVENT_CLICKED) {
        exit(2);
    }
}


static void inputbox_event_handler(lv_event_t * e)
{
    lv_event_code_t code = lv_event_get_code(e);
    lv_obj_t * obj = lv_event_get_target(e);
    if(code == LV_EVENT_VALUE_CHANGED) {
        inputbox_value = lv_textarea_get_text(obj);
    }
}


void inputbox_ui_init(int argc, char ** argv)
{
    lv_obj_t * label1 = lv_label_create(lv_scr_act());
    char * text = (argc > 2) ? argv[2] : "";
    lv_label_set_text(label1, text);

    lv_obj_t * ta = lv_textarea_create(lv_scr_act());
    lv_obj_set_size(ta, 200, 100);
    lv_obj_add_event_cb(ta, inputbox_event_handler,  LV_EVENT_ALL, NULL);

    lv_obj_t * kb = lv_keyboard_create(lv_scr_act());
    lv_keyboard_set_textarea(kb, ta);
    {
        lv_obj_t * btn = lv_btn_create(lv_scr_act());
        lv_obj_add_event_cb(btn, ok_inputbox_event_handler, LV_EVENT_ALL, NULL);
        lv_obj_t * label = lv_label_create(btn);
        lv_label_set_text(label, "OK");
        lv_obj_align(btn, LV_ALIGN_BOTTOM_LEFT, 0, 0);
    }
    {
        lv_obj_t * btn = lv_btn_create(lv_scr_act());
        lv_obj_add_event_cb(btn, cancel_inputbox_event_handler, LV_EVENT_ALL, NULL);
        lv_obj_t * label = lv_label_create(btn);
        lv_label_set_text(label, "Cancel");
        lv_obj_align(btn, LV_ALIGN_BOTTOM_RIGHT, 0, 0);
    }


}
```

## src/inputbox.h
```c
// -*- mode: C++; c-basic-offset: 4; indent-tabs-mode: nil -*-
// vim: ft=cpp:expandtab:ts=4:sw=4:softtabstop=4:
// SPDX-FileCopyrightText: Huawei Inc.
// SPDX-License-Identifier: MIT

#pragma once

void inputbox_ui_init(int argc, char ** argv);
```

## src/main_zephyr.c
```c
/*
 * Copyright (C) 2021 Bartosz Golaszewski <bartosz.golaszewski@huawei.com>
 *
 * SPDX-License-Identifier: Apache-2.0
 */

#include <device.h>
#include <drivers/display.h>
#include <lvgl.h>
#include <zephyr.h>

#define LOG_LEVEL CONFIG_LOG_DEFAULT_LEVEL
#include <logging/log.h>
LOG_MODULE_REGISTER(app);

void show_widget(void);

void main(void)
{
	const struct device *display_dev;

	display_dev = device_get_binding(CONFIG_LVGL_DISPLAY_DEV_NAME);
	if (!display_dev) {
		LOG_ERR("device not found. Aborting.");
		return;
	}

	show_widget();
	display_blanking_off(display_dev);
	lv_task_handler();

	while (1) {
		lv_task_handler();
		k_sleep(K_MSEC(10));
	}
}
```

## src/menu.c
```c
// -*- mode: C++; c-basic-offset: 4; indent-tabs-mode: nil -*-
// vim: ft=cpp:expandtab:ts=4:sw=4:softtabstop=4:
// SPDX-FileCopyrightText: Huawei Inc.
// SPDX-License-Identifier: MIT

#include <stdio.h>
#include <stdlib.h>
#include <lvgl/lvgl.h>
#include "menu.h"


static char * menu_selected_value = 0;


static void ok_menu_event_handler(lv_event_t * e)
{
    lv_event_code_t code = lv_event_get_code(e);
    lv_obj_t * obj = lv_event_get_target(e);
    if(code == LV_EVENT_CLICKED) {
        fprintf(stderr, "%s\n",  menu_selected_value);
        exit(0);
    }
}


static void cancel_menu_event_handler(lv_event_t * e)
{
    lv_event_code_t code = lv_event_get_code(e);
    lv_obj_t * obj = lv_event_get_target(e);
    if(code == LV_EVENT_CLICKED) {
        exit(2);
    }
}


static void menu_event_handler(lv_event_t * e)
{
    lv_event_code_t code = lv_event_get_code(e);
    lv_obj_t * btn = lv_event_get_target(e);
    if(code == LV_EVENT_CLICKED) {
        lv_obj_t * parent = lv_obj_get_parent(btn);
        for(uint32_t i = 0; i < lv_obj_get_child_cnt(parent); i++) {
            lv_obj_t * child = lv_obj_get_child(parent, i);
            if(child == btn) {
                menu_selected_value = lv_obj_get_user_data(btn);
                lv_obj_add_state(btn, LV_STATE_CHECKED);
                printf("TODO: check widget update %d\n", lv_obj_get_state(btn) && LV_STATE_CHECKED);

            }
            else {
                lv_obj_clear_state(child, LV_STATE_CHECKED);
            }
        }
    }
}


void menu_ui_init(int argc, char ** argv)
{
    lv_obj_t * label1 = lv_label_create(lv_scr_act());
    char * text = (argc > 2) ? argv[2] : "";
    lv_label_set_text(label1, text);

    lv_obj_t * list1 = lv_list_create(lv_scr_act());
    lv_obj_set_size(list1, 160, 200);
    uint32_t i = 3 + 3; // skip w,h,d
    while(i < argc) {
        char * title = argv[i++];
        char * desc = argv[i++];
        int len = strlen(title) + sizeof(':') + strlen(desc) + sizeof('\0');
        char * text = malloc(len);
        snprintf(text, len, "%s:%s", title, desc);
        lv_obj_t * btn = lv_list_add_btn(list1, NULL, text);
        lv_obj_set_user_data(btn, title);
        lv_obj_add_event_cb(btn, menu_event_handler, LV_EVENT_CLICKED, NULL);
    }
    lv_obj_t * currentButton = lv_obj_get_child(list1, 1);
    lv_obj_add_state(currentButton, LV_STATE_CHECKED);
    {
        lv_obj_t * btn = lv_btn_create(lv_scr_act());
        lv_obj_add_event_cb(btn, ok_menu_event_handler, LV_EVENT_ALL, NULL);
        lv_obj_t * label = lv_label_create(btn);
        lv_label_set_text(label, "OK");
    }
    {
        lv_obj_t * btn = lv_btn_create(lv_scr_act());
        lv_obj_add_event_cb(btn, cancel_menu_event_handler, LV_EVENT_ALL, NULL);
        lv_obj_t * label = lv_label_create(btn);
        lv_label_set_text(label, "Cancel");
    }
}
```

## src/menu.h
```c
// -*- mode: C++; c-basic-offset: 4; indent-tabs-mode: nil -*-
// vim: ft=cpp:expandtab:ts=4:sw=4:softtabstop=4:
// SPDX-FileCopyrightText: Huawei Inc.
// SPDX-License-Identifier: MIT

#pragma once

void menu_ui_init(int argc, char ** argv);
```

## src/msgbox.c
```c
// -*- mode: C++; c-basic-offset: 4; indent-tabs-mode: nil -*-
// vim: ft=cpp:expandtab:ts=4:sw=4:softtabstop=4:
// SPDX-FileCopyrightText: Huawei Inc.
// SPDX-License-Identifier: MIT

#include <stdlib.h>
#include <lvgl/lvgl.h>
#include "msgbox.h"

static void msgbox_event_handler(lv_event_t * e)
{
    lv_event_code_t code = lv_event_get_code(e);
    lv_obj_t * obj = lv_event_get_target(e);
    if(code == LV_EVENT_CLICKED) {
        exit(0);
    }
}

void msgbox_ui_init(int argc, char ** argv)
{
    lv_obj_t * label1 = lv_label_create(lv_scr_act());
    char * text = (argc > 2) ? argv[2] : "";
    lv_label_set_text(label1, text);

    lv_obj_t * btn = lv_btn_create(lv_scr_act());
    lv_obj_add_event_cb(btn, msgbox_event_handler, LV_EVENT_ALL, NULL);
    lv_obj_t * label = lv_label_create(btn);
    lv_label_set_text(label, "OK");
}
```

## src/msgbox.h
```c
// -*- mode: C++; c-basic-offset: 4; indent-tabs-mode: nil -*-
// vim: ft=cpp:expandtab:ts=4:sw=4:softtabstop=4:
// SPDX-FileCopyrightText: Huawei Inc.
// SPDX-License-Identifier: MIT
#pragma once

void msgbox_ui_init(int argc, char ** argv);
```

## src/sdl.c
```c
// -*- mode: C++; c-basic-offset: 4; indent-tabs-mode: nil -*-
// vim: ft=cpp:expandtab:ts=4:sw=4:softtabstop=4:
// SPDX-FileCopyrightText: Huawei Inc.
// SPDX-License-Identifier: MIT

#if defined(USE_SDL) && USE_SDL

#include <SDL2/SDL.h>
#include <lvgl/lv_drivers/sdl/sdl.h>


static int tick_thread(void * data)
{
    (void) data;
    while(true) {
        SDL_Delay(5);
        lv_tick_inc(5);
    }
}


void hal_init(void)
{
    sdl_init();

    static lv_disp_draw_buf_t draw_buf;
    static lv_color_t color_buf[SDL_HOR_RES * SDL_VER_RES];
    lv_disp_draw_buf_init(&draw_buf, color_buf, NULL,
                          SDL_HOR_RES * SDL_VER_RES
                         );

    static lv_disp_drv_t disp_drv;
    lv_disp_drv_init(&disp_drv);
    disp_drv.draw_buf = &draw_buf;
    disp_drv.hor_res = SDL_HOR_RES;
    disp_drv.ver_res = SDL_VER_RES;
    disp_drv.flush_cb = sdl_display_flush;
    lv_disp_t * disp = lv_disp_drv_register(&disp_drv);

    lv_theme_t * th = lv_theme_default_init(disp,
                                            lv_palette_main(LV_PALETTE_BLUE),
                                            lv_palette_main(LV_PALETTE_RED),
                                            LV_THEME_DEFAULT_DARK,
                                            LV_FONT_DEFAULT);
    lv_disp_set_theme(disp, th);

    lv_group_t * g = lv_group_create();
    lv_group_set_default(g);

    static lv_indev_drv_t mouse_drv;
    lv_indev_drv_init(&mouse_drv);
    mouse_drv.type = LV_INDEV_TYPE_POINTER;
    mouse_drv.read_cb = sdl_mouse_read;
    lv_indev_t * mouse_indev = lv_indev_drv_register(&mouse_drv);

    static lv_indev_drv_t keyboard_drv;
    lv_indev_drv_init(&keyboard_drv);
    keyboard_drv.type = LV_INDEV_TYPE_KEYPAD;
    keyboard_drv.read_cb = sdl_keyboard_read;

    SDL_CreateThread(tick_thread, "tick", NULL);
}

#endif
```

## src/wayland.c
```c
// -*- mode: C++; c-basic-offset: 4; indent-tabs-mode: nil -*-
// vim: ft=cpp:expandtab:ts=4:sw=4:softtabstop=4:
// SPDX-FileCopyrightText: Huawei Inc.
// SPDX-License-Identifier: MIT

#if defined(USE_WAYLAND) && USE_WAYLAND

#include <pthread.h>
#include <unistd.h>

#include <lv_drivers/wayland/wayland.h>


static void * tick_thread(void * data)
{
    (void) data;
    while(true) {
        usleep(5 * 1000);
        lv_tick_inc(5);
    }
}

void hal_init(void)
{
    wayland_init();

    static lv_disp_draw_buf_t draw_buf;
    static lv_color_t color_buf[WAYLAND_HOR_RES * WAYLAND_VER_RES];
    lv_disp_draw_buf_init(&draw_buf, color_buf, NULL,
                          WAYLAND_HOR_RES * WAYLAND_VER_RES
                         );

    static lv_disp_drv_t disp_drv;
    lv_disp_drv_init(&disp_drv);
    disp_drv.draw_buf = &draw_buf;
    disp_drv.hor_res = WAYLAND_HOR_RES;
    disp_drv.ver_res = WAYLAND_VER_RES;
    disp_drv.flush_cb = wayland_flush;
    lv_disp_t * disp = lv_disp_drv_register(&disp_drv);

    lv_theme_t * th = lv_theme_default_init(disp,
                                            lv_palette_main(LV_PALETTE_BLUE),
                                            lv_palette_main(LV_PALETTE_RED),
                                            LV_THEME_DEFAULT_DARK,
                                            LV_FONT_DEFAULT);
    lv_disp_set_theme(disp, th);

    lv_group_t * g = lv_group_create();
    lv_group_set_default(g);

    static lv_indev_drv_t mouse_drv;
    lv_indev_drv_init(&mouse_drv);
    mouse_drv.type = LV_INDEV_TYPE_POINTER;
    mouse_drv.read_cb = wayland_pointer_read;
    lv_indev_t * mouse_indev = lv_indev_drv_register(&mouse_drv);

    static lv_indev_drv_t touch_drv;
    lv_indev_drv_init(&touch_drv);
    touch_drv.type = LV_INDEV_TYPE_POINTER;
    touch_drv.read_cb = wayland_pointer_read;
    lv_indev_t * touch_indev = lv_indev_drv_register(&touch_drv);

    static lv_indev_drv_t keyboard_drv;
    lv_indev_drv_init(&keyboard_drv);
    keyboard_drv.type = LV_INDEV_TYPE_KEYPAD;
    keyboard_drv.read_cb = wayland_keyboard_read;

    lv_indev_t * keyboard_indev = lv_indev_drv_register(&keyboard_drv);
    lv_indev_set_group(keyboard_indev, g);

    static pthread_t hal_thread;
    pthread_create(&hal_thread, NULL, tick_thread, NULL);
}


#endif
```

## src/yesno.c
```c
// -*- mode: C++; c-basic-offset: 4; indent-tabs-mode: nil -*-
// vim: ft=cpp:expandtab:ts=4:sw=4:softtabstop=4:
// SPDX-FileCopyrightText: Huawei Inc.
// SPDX-License-Identifier: MIT

#include <stdlib.h>
#include <lvgl/lvgl.h>
#include "yesno.h"


static void yes_event_handler(lv_event_t * e)
{
    lv_event_code_t code = lv_event_get_code(e);
    lv_obj_t * obj = lv_event_get_target(e);
    if(code == LV_EVENT_CLICKED) {
        exit(0);
    }
}


static void no_event_handler(lv_event_t * e)
{
    lv_event_code_t code = lv_event_get_code(e);
    lv_obj_t * obj = lv_event_get_target(e);
    if(code == LV_EVENT_CLICKED) {
        exit(2);
    }
}


void yesno_ui_init(int argc, char ** argv)
{
    lv_obj_t * label1 = lv_label_create(lv_scr_act());
    char * text = (argc > 2) ? argv[2] : "";
    lv_label_set_text(label1, text);

    lv_obj_t * yesbtn = lv_btn_create(lv_scr_act());
    lv_obj_align(yesbtn, LV_ALIGN_LEFT_MID, 10, 0);
    lv_obj_add_event_cb(yesbtn, yes_event_handler, LV_EVENT_ALL, NULL);
    lv_obj_t * yeslabel = lv_label_create(yesbtn);
    lv_label_set_text(yeslabel, "Yes");

    lv_obj_t * nobtn = lv_btn_create(lv_scr_act());
    lv_obj_align(nobtn, LV_ALIGN_LEFT_MID, 10, 0);
    lv_obj_add_event_cb(nobtn, no_event_handler, LV_EVENT_ALL, NULL);
    lv_obj_t * nolabel = lv_label_create(nobtn);
    lv_label_set_text(nolabel, "No");
}
```
